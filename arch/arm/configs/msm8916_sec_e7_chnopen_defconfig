## arch/arm/configs/msm8916_sec_e7_chnopen_defconfig
```kconfig
CONFIG_SEC_E7_PROJECT=y
CONFIG_MACH_E7_CHN_OPEN=y

# HARD RESET
CONFIG_RESTART_REASON_SEC_PARAM=y

# MUIC
CONFIG_SM5502_MUIC=y
CONFIG_SM5504_MUIC=y
CONFIG_MUIC_SUPPORT_RUSTPROOF_INBATT=y
CONFIG_USBID_STANDARD_VER_01=y
CONFIG_MUIC_SUPPORT_CHARGING_CABLE=y
CONFIG_MUIC_SUPPORT_DESKDOCK=y

# IFPMIC
CONFIG_MFD_RT5033_RESET_WA=y

#LCD
CONFIG_PANEL_EA8061_HD=y

#Touch Key
CONFIG_KEYBOARD_TC360_TKEY=y
CONFIG_INPUT_BOOSTER=y

#Touch Screen
CONFIG_TOUCHSCREEN_FTS=y

#Vibrator
CONFIG_MSM_VIBRATOR=y

#HALL IC
CONFIG_SENSORS_HALL=y

#AUDIO
CONFIG_AUDIO_SPEAKER_OUT_NXP_AMP_ENABLE=y
CONFIG_AUDIO_QUAT_I2S_ENABLE=y

#BATTERY
CONFIG_MFD_RT5033=y
CONFIG_BATTERY_SAMSUNG=y
CONFIG_BATTERY_SAMSUNG_DATA_FILE="e7_battery_data.h"
CONFIG_SAMSUNG_LPM_MODE=y
CONFIG_CHARGER_RT5033=y
CONFIG_FUELGAUGE_RT5033=y
CONFIG_REGULATOR_RT5033=y
CONFIG_MFD_RT5033_RESET_WA=y
CONFIG_MFD_RT5033_SLDO_VBUSDET=n
CONFIG_BATTERY_SWELLING=y

#NFC
CONFIG_NFC=y
CONFIG_SEC_NFC=y
CONFIG_SEC_NFC_IF_I2C=y
CONFIG_SEC_NFC_PRODUCT_N5=y
CONFIG_SEC_NFC_USE_8916_BBCLK2=y

#FLASH
CONFIG_FLASHLIGHT=y
CONFIG_RT_FLASH_LED=y
CONFIG_FLED_RT5033=y
CONFIG_FLED_RT5033_EXT_GPIO=y

#CAMERA
CONFIG_CAM_USE_EXT_VANA_GPIO=y
CONFIG_S5K3L2XX=y
CONFIG_S5K5E3YX=y
#CONFIG_MSM_OTP is not set
#CONFIG_SPI_QUP is not set

#SENSOR
CONFIG_SENSORS=y
CONFIG_SENSORS_CORE=y
CONFIG_SENSORS_K2HH=y
CONFIG_SENSORS_CM36672P=y
CONFIG_SENSORS_LEDA_EN_GPIO=y

#MMC
CONFIG_SEC_HYBRID_TRAY=y

# DUAL SIM / SINGLE SIM Detection
CONFIG_CHECK_SIMSLOT_COUNT=y
# CONFIG_CHECK_SIMSLOT_COUNT_GPIO is not set
CONFIG_CHECK_SIMSLOT_COUNT_DT=y

#Power off Alarm
CONFIG_RTC_AUTO_PWRON=y
CONFIG_RTC_AUTO_PWRON_PARAM=y

# SSWAP
CONFIG_SWAP=y
CONFIG_FRONTSWAP=y
CONFIG_ZSMALLOC=y
CONFIG_ZSWAP=y
```

## arch/arm/configs/msm8916_sec_grandmax_kor_defconfig
```kconfig
CONFIG_SEC_GRANDMAX_PROJECT=y
CONFIG_MACH_GRANDMAX_KOR_OPEN=y

CONFIG_RESTART_REASON_SEC_PARAM=y

# SS Pinctrl Driver
CONFIG_SEC_GPIO_SETTINGS=y

# MUIC
CONFIG_SM5504_MUIC=y
CONFIG_USBID_STANDARD_VER_01=y
CONFIG_MUIC_SUPPORT_RUSTPROOF=y
#CONFIG_MUIC_SUPPORT_DESKDOCK is not set
CONFIG_MUIC_SUPPORT_CHARGING_CABLE=y

#USB Host
CONFIG_USB_HOST_NOTIFY=y

#Touch Screen
CONFIG_TOUCHSCREEN_IST30XX_O1=y
CONFIG_TOUCHSCREEN_TA_CALLBACK_ENABLE=y

# Vibrator
CONFIG_MSM_VIBRATOR=y

#LCD
CONFIG_PANEL_S6D2AA0X_LPM053A250A_HD=y
CONFIG_MFD_ISL98611=y

#SENSOR
CONFIG_SENSORS=y
CONFIG_SENSORS_CORE=y
CONFIG_SENSORS_K2HH=y
CONFIG_SENSORS_AK09911C=y
CONFIG_SENSORS_CM36686=y
CONFIG_SENSORS_CM36686_LEDA_EN_GPIO=y

#FLASH
CONFIG_FLASHLIGHT=y
CONFIG_RT_FLASH_LED=y
CONFIG_FLED_RT5033=y
CONFIG_FLED_RT5033_EXT_GPIO=y

#CAMERA
CONFIG_IMX135=y
CONFIG_S5K5E3YX=y
CONFIG_FRONT_EEPROM=y

#Wifi
#
# Enable Qualcomm Wifi features
#
CONFIG_MSM_PIL_PRONTO=y
CONFIG_WCNSS_CORE=y
CONFIG_WCNSS_CORE_PRONTO=y
CONFIG_WCNSS_MEM_PRE_ALLOC=y

#
# Wifi features (Qualcomm)
#
CONFIG_NET_CORE=y
CONFIG_WIRELESS=y
CONFIG_WIRELESS_EXT_SYSFS=y
CONFIG_WEXT_CORE=y
CONFIG_WEXT_PROC=y
CONFIG_CFG80211=y
CONFIG_CFG80211_DEFAULT_PS=y
#CONFIG_CFG80211_ALLOW_RECONNECT is not set
CONFIG_WLAN=y
CONFIG_WIRELESS_EXT=y
CONFIG_WEXT_PRIV=y
CONFIG_MODULES=y
CONFIG_MODULE_UNLOAD=y
#CONFIG_MODULE_FORCE_UNLOAD is not set
CONFIG_WCNSS_REGISTER_DUMP_ON_BITE =y

#Power off Alarm
CONFIG_RTC_AUTO_PWRON=y
CONFIG_RTC_AUTO_PWRON_PARAM=y

#AUDIO
CONFIG_RADIO_IRIS=y
CONFIG_RADIO_IRIS_TRANSPORT=m
CONFIG_AUDIO_SPEAKER_OUT_NXP_AMP_ENABLE=y
CONFIG_AUDIO_QUAT_I2S_ENABLE=y

#optimize mmc block delay on resume
CONFIG_MMC_BLOCK_DEFERRED_RESUME=y

# Charging/Battery
CONFIG_MFD_RT5033=y
CONFIG_REGULATOR_RT5033=y
CONFIG_CHARGER_RT5033=y
CONFIG_BATTERY_SAMSUNG=y
CONFIG_BATTERY_SAMSUNG_DATA_FILE="grandmax_battery_data.h"
CONFIG_SAMSUNG_LPM_MODE=y
CONFIG_FUELGAUGE_RT5033=y
CONFIG_MFD_RT5033_RESET_WA=y
CONFIG_MFD_RT5033_RESET_GPIO=y
CONFIG_MFD_RT5033_SLDO_VBUSDET=y

# DMB
CONFIG_TDMB=y
CONFIG_TDMB_VENDOR_FCI=y
CONFIG_TDMB_FC8080=y
CONFIG_TDMB_SPI=y
CONFIG_TDMB_QUALCOMM=y

# SSWAP
CONFIG_SWAP=y
CONFIG_FRONTSWAP=y
CONFIG_ZSMALLOC=y
CONFIG_PGTABLE_MAPPING=y
CONFIG_ZSWAP=y
CONFIG_ZPOOL=y
CONFIG_DIRECT_RECLAIM_FILE_PAGES_ONLY=y
CONFIG_INCREASE_MAXIMUM_SWAPPINESS=y
CONFIG_FIX_INACTIVE_RATIO=y
CONFIG_TIGHT_PGDAT_BALANCE=y
CONFIG_VNSWAP=y
CONFIG_SWAP_ENABLE_READAHEAD=n

#EPDG
CONFIG_NET_CORE=y
CONFIG_NET_SCH_PRIO=y
CONFIG_NET_SCHED=y   #depends on CONFIG_NET  which is enabled by default.. coz not seeing in the config file
CONFIG_NET_CLS_BASIC=y # required if basic is being used as a filter. depends on CONFIG_NET_CLS so enabling it by default
CONFIG_NET_CLS=y
CONFIG_NET_CLS_ACT=y # for enabling the action target.
CONFIG_NET_ACT_MIRRED=y  # for enabling the mirred target for redirecting the packet between the devices.
CONFIG_NET_EMATCH=y   #basic uses extended matches so this has to be present
CONFIG_NET_SCH_INGRESS=y # classifier for ingress packet
#EPDG
```

## arch/arm/configs/msm8916_sec_on7nlte_skt_defconfig
```kconfig
CONFIG_SEC_ON7N_PROJECT=y
CONFIG_MACH_ON7NLTE_KOR_SKT=y

CONFIG_RESTART_REASON_SEC_PARAM=y

# SS Pinctrl Driver
CONFIG_SEC_GPIO_SETTINGS=y

# MUIC
CONFIG_SM5703_MUIC=y
CONFIG_USBID_STANDARD_VER_01=y
#CONFIG_MUIC_SUPPORT_CHARGING_CABLE is not set
CONFIG_MUIC_SUPPORT_RUSTPROOF=y
#CONFIG_MUIC_SUPPORT_DESKDOCK is not set

#Touch Screen
CONFIG_TOUCHSCREEN_ZT7538_TS=y

# Vibrator
CONFIG_SM5703_VIBRATOR=y

# HALL IC
#CONFIG_SENSORS_HALL is not set

#LCD
CONFIG_PANEL_S6D7AA0X62_BV050HDM_HD_5_5=y
CONFIG_PANEL_ILI9881C_SKI550002_HD=y
CONFIG_MFD_LM3632=y

#SENSOR
CONFIG_SENSORS=y
CONFIG_SENSORS_CORE=y
CONFIG_SENSORS_K2HH=y
CONFIG_SENSORS_STK3013=y

#NFC
CONFIG_NFC=y
CONFIG_NFC_PN547=y
CONFIG_NFC_PN547_8916_USE_BBCLK2=y
CONFIG_NFC_PN547_8916_CLK_CTL=y
CONFIG_NFC_PN547_PVDD_EN_CONTROL=y

#FLASH
CONFIG_FLASHLIGHT=y
CONFIG_SM_FLASH_LED=y
CONFIG_FLED_SM5703=y
CONFIG_FLED_SM5703_EXT_GPIO=y
#CONFIG_FLED_LM3632=y
#CONFIG_FLED_KTD2692=y
#CONFIG_FRONT_FLASH=y

#CAMERA
CONFIG_S5K3L2XX=y
CONFIG_S5K5E3YX=y
CONFIG_CAMERA_SYSFS_V2=y
CONFIG_SW_LANDING_FOR_MULTI_TASKING=y

#AUDIO
CONFIG_SW_100K_TO_GND=y
CONFIG_SEC_DEVIDE_RINGTONE_GAIN=y

#optimize mmc block delay on resume
CONFIG_MMC_BLOCK_DEFERRED_RESUME=y

# IPSec
CONFIG_CRYPTO_NULL=y

# Charging/Battery
CONFIG_MFD_SM5703=y
CONFIG_REGULATOR_SM5703=y
CONFIG_CHARGER_SM5703=y
CONFIG_BATTERY_SAMSUNG=y
CONFIG_BATTERY_SAMSUNG_DATA_FILE="on7_battery_data.h"
CONFIG_SAMSUNG_LPM_MODE=y
CONFIG_FUELGAUGE_SM5703=y
CONFIG_BATTERY_SWELLING=y
CONFIG_SIOP_CHARGING_LIMIT_CURRENT=1000
CONFIG_PREVENT_SOC_JUMP=y
CONFIG_CHARGER_SM5703_DUALPATH=y
CONFIG_DISABLE_MINIMUM_SIOP_CHARGING=y

# DUAL SIM / SINGLE SIM Detection
CONFIG_CHECK_SIMSLOT_COUNT=y
# CONFIG_CHECK_SIMSLOT_COUNT_GPIO is not set
CONFIG_CHECK_SIMSLOT_COUNT_DT=y

# SSWAP
CONFIG_SWAP=y
CONFIG_FRONTSWAP=y
CONFIG_ZSMALLOC=y
CONFIG_ZSWAP=y

#APC CPR QUOTIENT
CONFIG_APC_CPR_QUOT_BOOST=y

# MMAP READAROUND
CONFIG_MMAP_READAROUND_LIMIT=16
```
